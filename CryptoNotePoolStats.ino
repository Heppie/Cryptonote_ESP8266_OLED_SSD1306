#include <ArduinoJson.h>
#include <Wire.h>
#include <Adafruit_SSD1306.h>
#include <Adafruit_GFX.h>
#include <ESP8266WiFi.h>
#include "esp8266httpclient.h"

Adafruit_SSD1306 display(D6);

const char* ssid     = "SSID";
const char* password = "PASSWORD";
String JsonResponse;

const unsigned char ETNLogo[] PROGMEM = {
  0x00, 0x00, 0x00, 0x00, 0x00, 0x00, 0x00, 0x00, 0x00, 0x00, 0x00, 0x00, 0x00, 0x00, 0x00, 0x00,
  0x00, 0x00, 0x00, 0x00, 0x00, 0x00, 0x00, 0x00, 0x00, 0x00, 0x00, 0x00, 0x00, 0x00, 0x00, 0x00,
  0x00, 0x00, 0x00, 0x00, 0x00, 0x00, 0x00, 0x00, 0x00, 0x00, 0x00, 0x00, 0x00, 0x00, 0x00, 0x00,
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  0x00, 0x00, 0x00, 0x00, 0x00, 0x00, 0x00, 0x00, 0x00, 0x00, 0x00, 0x00, 0x00, 0x00, 0x00, 0x00
};

void setup() {

  display.begin(SSD1306_SWITCHCAPVCC, 0x3C);
  display.setRotation(2);
  display.setTextSize(1);
  display.setTextColor(WHITE);
  display.clearDisplay();
  WiFi.mode(WIFI_STA);
  WiFi.begin(ssid, password);
  display.drawBitmap(0, 0,  ETNLogo, 128, 32, 1);
  display.display();
  delay(2000);
  display.clearDisplay();
  display.setCursor(0, 0);
  display.println("Connecting to WiFi");
  display.display();
  delay(2000);

  while (WiFi.status() != WL_CONNECTED) {
    display.clearDisplay();
    display.setCursor(0, 0);
    display.println("Connecting to WiFi...");
    display.display();
    delay(2000);
    display.clearDisplay();
  }
  display.clearDisplay();
  display.setCursor(0, 0);
  display.println("WiFi Connected!");
  display.setCursor(0, 10);
  display.println(WiFi.localIP());
  display.display();
  delay(2000);
}

void loop() {
  if (WiFi.status() == WL_CONNECTED)
  {
    GetMinerJson();
    DynamicJsonBuffer jsonBuffer;
    JsonObject& root = jsonBuffer.parseObject(JsonResponse);
    JsonObject& stats = root["stats"];
    const char* stats_hashes = stats["hashes"]; // "60375505"
    const char* stats_lastShare = stats["lastShare"]; // "1510006522"
    const float stats_balance = stats["balance"]; // "101"
    const float stats_paid = stats["paid"]; // "4500"
    const String stats_hashrate = stats["hashrate"]; // "239.00 H"
    int DecimalIndex = stats_hashrate.indexOf('.');

    display.clearDisplay();
    display.setCursor(0, 0);
    display.print("Hashrate: ");
    display.print(stats_hashrate.substring(0, DecimalIndex));
    display.print(stats_hashrate.substring(DecimalIndex + 3));
    display.print("/s");
    display.setCursor(0, 10);
    display.print("Pending: ");
    display.print(stats_balance / 100);
    display.print(" ETN");
    display.setCursor(0, 20);
    display.print("Paid: ");
    display.print(stats_paid / 100);
    display.print(" ETN");
    display.display();

  }
  delay(30000);
}

void GetMinerJson()
{
  HTTPClient http;
  http.begin("http://electroneum.hashparty.io:8117/stats_address?longpoll=false&address=WALLETADDRESSHERE");
  int httpCode = http.GET();
  if (httpCode > 0) { //Check the returning code
    JsonResponse = http.getString();   //Get the request response payload
  }

  http.end();   //Close connection

}

void GetPoolJson()
{
  HTTPClient http;
  http.begin("http://52.191.161.211:8117/stats");
  int httpCode = http.GET();
  if (httpCode > 0) { //Check the returning code
    JsonResponse = http.getString();   //Get the request response payload
  }

  http.end();   //Close connection
}


